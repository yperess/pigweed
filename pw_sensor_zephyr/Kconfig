## pw_sensor_zephyr/Kconfig
```kconfig
# Copyright 2024 The Pigweed Authors
#
# Licensed under the Apache License, Version 2.0 (the "License"); you may not
# use this file except in compliance with the License. You may obtain a copy of
# the License at
#
#     https://www.apache.org/licenses/LICENSE-2.0
#
# Unless required by applicable law or agreed to in writing, software
# distributed under the License is distributed on an "AS IS" BASIS, WITHOUT
# WARRANTIES OR CONDITIONS OF ANY KIND, either express or implied. See the
# License for the specific language governing permissions and limitations under
# the License.

menu "pw_sensor"

config PIGWEED_SENSOR
  bool "Link pw_sensor library"
  select SENSOR
  select PIGWEED_CHRONO_SYSTEM_CLOCK
  select PIGWEED_SYNC_BINARY_SEMAPHORE
  select PIGWEED_SYNC_INTERRUPT_SPIN_LOCK
#  select PIGWEED_SYNC_MUTEX
  select PIGWEED_SYNC_THREAD_NOTIFICATION
  select PIGWEED_SYNC_TIMED_THREAD_NOTIFICATION
  help
    See :ref:`module-pw_sensor` for module details.

endmenu
```
